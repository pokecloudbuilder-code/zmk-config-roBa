## config/west.yml
```yaml
manifest:
  remotes:
    - name: zmkfirmware
      url-base: https://github.com/zmkfirmware
    - name: kumamuk-git
      url-base: https://github.com/kumamuk-git
  projects:
    - name: zmk
      remote: zmkfirmware
      revision: f9be3ed9c08b35b1b86df24c0f04913f3b5e50f5
      import: app/west.yml
    - name: zmk-pmw3610-driver
      remote: kumamuk-git
      revision: 3d97a3e
  self:
    path: config
```
